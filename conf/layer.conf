## conf/layer.conf
```bitbake
# We have a conf and classes directory, add to BBPATH
BBPATH .= ":${LAYERDIR}"

# We have a recipes-* directories, add to BBFILES
BBFILES += "${LAYERDIR}/recipes-*/*/*.bb \
        ${LAYERDIR}/recipes-*/*/*.bbappend"

BBFILE_COLLECTIONS += "lx2k-layer"
BBFILE_PATTERN_lx2k-layer = "^${LAYERDIR}/"
BBFILE_PRIORITY_lx2k-layer = "5"

LAYERDEPENDS_lx2k-layer = "core openembedded-layer"
LAYERSERIES_COMPAT_lx2k-layer = "zeus dunfell"
```

## conf/machine/honeycomb_lx2k.conf
```bitbake
#@TYPE: Machine
#@NAME: SolidRun HoneyComb LX2K
#@DESCRIPTION: A NXP LX2160A based development board

require conf/machine/include/arm/arch-arm64.inc

PREFERRED_VERSION_trusted-firmware-a ?= "1.5%"
PREFERRED_VERSION_fiptool-native ?= "1.5%"

PREFERRED_VERSION_u-boot = "2019.10"
UBOOT_MACHINE ?= "lx2160acex7_tfa_defconfig"
UBOOT_ENTRYPOINT = "0x80080000"
UBOOT_DTB_LOADADDRESS = "0x90000000"

PREFERRED_PROVIDER_virtual/kernel ?= "linux-lx2k"
KERNEL_IMAGETYPE = "Image.gz"
KERNEL_DEVICETREE = "freescale/fsl-lx2160a-cex7.dtb"
KERNEL_CLASSES = "kernel-fitimage"
KERNEL_IMAGETYPES = "fitImage"

FIT_HASH_ALG = "crc32"

MACHINE_EXTRA_RRECOMMENDS += "kernel-modules"
EXTRA_IMAGEDEPENDS += "trusted-firmware-a u-boot rcw ddr-phy-binary qoriq-mc-binary mc-utils"

IMAGE_BOOT_FILES ?= "fsl-lx2160a-cex7.dtb fitImage"
IMAGE_FSTYPES += "tar.gz wic lx2k_fw_img"
IMAGE_CLASSES += "lx2k_fw_img"
WKS_FILE ?= "honeycomb-lx2k-fw-sd-image.wks"

SERIAL_CONSOLES = "115200;ttyAMA0"

# Available DDR speed options are 2400, 2600, 2900, and 3200
DDR_SPEED = "2600"

# Available SerDes configs are 8_5_2 (8x10g), 13_5_2 (dual 100g), or 20_5_2 (dual 40g)
SERDES = "8_5_2"

# Boot image location, sd or xspi
BOOT = "sd"
```

## wic/honeycomb-lx2k-fw-sd-image.wks
```
part spl --source rawcopy --sourceparams="file=bl2_sd.pbl" --ondisk mmcblk0 --no-table --align 4 --size 1020k
part spl --source rawcopy --sourceparams="file=fip.bin" --ondisk mmcblk0 --no-table --align 4 --size 7M
part spl --source rawcopy --sourceparams="file=fip_ddr_all.bin" --ondisk mmcblk0 --no-table --size=4k --size 2M
part spl --source rawcopy --sourceparams="file=mc_10.20.4_lx2160a.itb" --ondisk mmcblk0 --no-table --align 4 --size 3M
part spl --source rawcopy --sourceparams="file=dpl-eth.8x10g.19.dtb" --ondisk mmcblk0 --no-table --align 4 --size 1M
part spl --source rawcopy --sourceparams="file=dpc-8_x_usxgmii.dtb" --ondisk mmcblk0 --no-table --align 4 --size 2M
part spl --source rawcopy --sourceparams="file=fitImage" --ondisk mmcblk0 --no-table --align 4

part /boot --source bootimg-partition --ondisk mmcblk0 --fstype=vfat --label boot --active --align 4 --size 16 --sourceparams="loader=u-boot" --use-uuid
part / --source rootfs --ondisk mmcblk0 --fstype=ext4 --label root --align 4 --use-uuid
#bootloader --append="root=/dev/nvme0n1p1 console=ttyAMA0,115200 pci=pcie_bus_safe"
```

## wic/honeycomb-lx2k-sd-image.wks
```
part /boot --source bootimg-partition --ondisk mmcblk0 --fstype=vfat --label boot --active --align 4 --size 16 --sourceparams="loader=u-boot" --use-uuid

part / --source rootfs --ondisk mmcblk0 --fstype=ext4 --label root --align 4 --use-uuid

bootloader --append="root=/dev/mmcblk0p2 console=ttyAMA0,115200 pci=pcie_bus_safe"
```
